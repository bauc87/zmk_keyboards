/ {
    combos {
        compatible = "zmk,combos";

        /* =========================
         * COLON – D + F
         * D = 14, F = 15
         * ========================= */
        combo_colon {
            timeout-ms = <30>;
            bindings = <&kp COLON>;
            key-positions = <14 15>;
        };
    };
};
